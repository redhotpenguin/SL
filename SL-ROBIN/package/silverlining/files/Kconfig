## SL-ROBIN/package/silverlining/files/Kconfig
```kconfig
config NF_NAT_SL
	tristate
	default m

config NF_CONNTRACK_SL
	tristate "SL protocol support"
	depends on NF_CONNTRACK
	help
	  Tracking SL connections is problematic: special helpers are
	  required for tracking them, and doing masquerading and other forms
	  of Network Address Translation on them.

	  This is SL support on Layer 3 independent connection tracking.
	  Layer 3 independent connection tracking is experimental scheme
	  which generalize ip_conntrack to support other layer 3 protocols.

	  To compile it as a module, choose M here.  If unsure, say N.
```
